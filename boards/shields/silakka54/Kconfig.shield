## boards/shields/silakka54/Kconfig.shield
```kconfig
# No whitespace after the comma or in the keyboard name!
config SHIELD_SILAKKA54_DONGLE
    def_bool $(shields_list_contains,silakka54_dongle)
```
